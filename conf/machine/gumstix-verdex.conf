## conf/machine/gumstix-verdex.conf
```bitbake
# Use this file as a strating point for your custom verdex configuration
# Edit it to reflect your hardware setup and then save it to a parallel
# location in user.collection

require conf/machine/include/gumstix.inc
PACKAGE_EXTRA_ARCHS += "iwmmxt"

MACHINE_FEATURES += "verdex"
MACHINE_FEATURES += "iwmmxt"

KERNEL_IMAGE_MAXSIZE = "2097153" 

#
# Your flash size = Total flash [MB] - 2 [MB] for linux kernel partition
ROOT_FLASH_SIZE = "14"
#ROOT_FLASH_SIZE = "30"

#
# Enable use of virtual terminal for LCD ontty1 if USE_VT = "1"
#USE_VT = "0"
USE_VT = "1"
SYSVINIT_ENABLED_GETTYS = "1"

PREFERRED_PROVIDER_virtual/xserver = "xserver-xorg"
XSERVER = "xserver-xorg \
           xf86-input-evdev \
           xf86-input-mouse \
           xf86-input-tslib \
           xf86-video-fbdev \
           xf86-input-keyboard"
#
# Uncomment features that your board set supports
MACHINE_FEATURES += "usbhost"
#MACHINE_FEATURES += "usbgadget"

MACHINE_FEATURES += "i2c"
#MACHINE_FEATURES += "spi"

MACHINE_FEATURES += "serial"
#MACHINE_FEATURES += "bluetooth"
MACHINE_FEATURES += "sound"

# disable both "lcd" and "touchscreen" features if you are using a robostix
#MACHINE_FEATURES += "robostix"

MACHINE_FEATURES += "lcd"
MACHINE_FEATURES += "rgb16"
#MACHINE_FEATURES += "rgb18"

MACHINE_FEATURES += "touchscreen"
MACHINE_FEATURES += "keyboard"

MACHINE_FEATURES += "pcmcia"
MACHINE_FEATURES += "mmc"

MACHINE_FEATURES += "wifi"
MACHINE_FEATURES += "ethernet"

MACHINE_FEATURES += "ext2"
MACHINE_FEATURES += "fat"
MACHINE_FEATURES += "ext3"

# enable one of the following if you want to target your build for uimage|rootfs
# on a mmc/microSD or CF card
MACHINE_FEATURES += "mmcroot"
#MACHINE_FEATURES += "cfroot"

#
# note: selection of MACHINE_FEATURES above will automatically include the
# necessary kernel modules for those features via task-base.
# Include below any extra kernel modules that you want installed
#MACHINE_ESSENTIAL_EXTRA_RRECOMMENDS += "kernel-module-xxxxxxx"
MACHINE_EXTRA_RRECOMMENDS += "\
	kernel-module-proc-gpio \
	kernel-module-rtc-drv-pxa \
	kernel-module-libertas \
	kernel-module-libertas-cs \
	"

#
# Uncomment or add kernel modules that should be autoloaded
module_autoload_proc-gpio      = 'proc-gpio'
module_autoload_rtc-drv-pxa    = 'rtc-drv-pxa'

module_autoload_pcmcia         = ${@base_contains('MACHINE_FEATURES', 'pcmcia',     'pcmcia', '',d)}
module_autoload_pxa2xx_cs      = ${@base_contains('MACHINE_FEATURES', 'pcmcia',     'pxa2xx_cs', '',d)}

module_autoload_pxamci         = ${@base_contains('MACHINE_FEATURES', 'mmc',        'pxamci', '',d)}
module_autoload_mmc_block      = ${@base_contains('MACHINE_FEATURES', 'mmc',        'mmc_block', '',d)}

module_autoload_ethernet       = ${@base_contains('MACHINE_FEATURES', 'ethernet',   'ethernet', '',d)}
module_autoload_smsc911x       = ${@base_contains('MACHINE_FEATURES', 'ethernet',   'smsc911x', '',d)}

module_autoload_ohci-hcd       = ${@base_contains('MACHINE_FEATURES', 'usbhost',    'ohci-hcd', '',d)}
module_autoload_gumstix_gadget = ${@base_contains('MACHINE_FEATURES', 'usbgadget',  'gumstix_gadget', '',d)}
module_autoload_g_file_storage = ${@base_contains('MACHINE_FEATURES', 'usbgadget',  'g_file_storage', '',d)}
module_autoload_g_ether        = ${@base_contains('MACHINE_FEATURES', 'usbgadget',  'g_ether', '',d)}
module_autoload_g_serial       = ${@base_contains('MACHINE_FEATURES', 'usbgadget',  'g_serial', '',d)}

module_autoload_tsc2003        = ${@base_contains('MACHINE_FEATURES', 'touchscreen','tsc2003', '',d)}
module_autoload_tsc2007        = ${@base_contains('MACHINE_FEATURES', 'touchscreen','tsc2007', '',d)}
module_autoload_ucb1400-ts     = ${@base_contains('MACHINE_FEATURES', 'touchscreen','ucb1400-ts', '',d)}
module_autoload_evdev          = ${@base_contains('MACHINE_FEATURES', 'touchscreen','evdev', '',d)}
```
